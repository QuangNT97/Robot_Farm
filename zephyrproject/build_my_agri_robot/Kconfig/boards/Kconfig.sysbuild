## zephyrproject/build_my_agri_robot/Kconfig/boards/Kconfig.sysbuild
```kconfig
# Load Sysbuild board Kconfig descriptions.
osource "D:/DOCUMENT/RoboLife_Farm/zephyrproject/zephyr/boards/others/black_f407ve/Kconfig.sysbuild"
```

## zephyrproject/build_my_agri_robot_west/Kconfig/arch/Kconfig
```kconfig
# Load Zephyr Arch Kconfig descriptions.
osource "D:/DOCUMENT/RoboLife_Farm/zephyrproject/zephyr/arch/rx/Kconfig"
osource "D:/DOCUMENT/RoboLife_Farm/zephyrproject/zephyr/arch/x86/Kconfig"
osource "D:/DOCUMENT/RoboLife_Farm/zephyrproject/zephyr/arch/xtensa/Kconfig"
osource "D:/DOCUMENT/RoboLife_Farm/zephyrproject/zephyr/arch/sparc/Kconfig"
osource "D:/DOCUMENT/RoboLife_Farm/zephyrproject/zephyr/arch/riscv/Kconfig"
osource "D:/DOCUMENT/RoboLife_Farm/zephyrproject/zephyr/arch/posix/Kconfig"
osource "D:/DOCUMENT/RoboLife_Farm/zephyrproject/zephyr/arch/openrisc/Kconfig"
osource "D:/DOCUMENT/RoboLife_Farm/zephyrproject/zephyr/arch/mips/Kconfig"
osource "D:/DOCUMENT/RoboLife_Farm/zephyrproject/zephyr/arch/arm64/Kconfig"
osource "D:/DOCUMENT/RoboLife_Farm/zephyrproject/zephyr/arch/arm/Kconfig"
osource "D:/DOCUMENT/RoboLife_Farm/zephyrproject/zephyr/arch/arc/Kconfig"
```

## zephyrproject/build_my_agri_robot_west/Kconfig/boards/Kconfig.black_f407ve
```kconfig
# Load board Kconfig descriptions.
osource "D:/DOCUMENT/RoboLife_Farm/zephyrproject/zephyr/boards/others/black_f407ve/Kconfig.black_f407ve"
```

## zephyrproject/build_my_agri_robot_west/Kconfig/boards/Kconfig.defconfig
```kconfig
# Load Zephyr board defconfig descriptions.
osource "D:/DOCUMENT/RoboLife_Farm/zephyrproject/zephyr/boards/others/black_f407ve/Kconfig.defconfig"
```
